## DI4/main/Kconfig.projbuild
```kconfig
menu "MECS DI4 input node"
config MECS_NODE_ID
    int "Node address"
    range 1 127
    default 2
endmenu
```

## DI4/sdkconfig.defaults
```kconfig
CONFIG_IDF_TARGET="esp32c3"
CONFIG_ESP_CONSOLE_USB_SERIAL_JTAG=y
CONFIG_ESP_CONSOLE_SECONDARY_NONE=y
CONFIG_FREERTOS_HZ=1000
CONFIG_MECS_NODE_ID=2
```

## DO4/main/Kconfig.projbuild
```kconfig
menu "MECS DO4 output node"
config MECS_NODE_ID
    int "Node address"
    range 1 127
    default 1
config MECS_OUTPUT_ACTIVE_LOW
    bool "Output drivers are active-low at boot"
    default n
    help
        Select this to match the external output driver. Runtime polarity is volatile.
endmenu
```

## DO4/sdkconfig.defaults
```kconfig
CONFIG_IDF_TARGET="esp32c3"
CONFIG_ESP_CONSOLE_USB_SERIAL_JTAG=y
CONFIG_ESP_CONSOLE_SECONDARY_NONE=y
CONFIG_FREERTOS_HZ=1000
CONFIG_MIO_NODE_ID=1
# CONFIG_MIO_OUTPUT_ACTIVE_LOW is not set
```
